## buildroot/configs/l3plus_ntp_defconfig
```kconfig
BR2_arm=y
BR2_cortex_a8=y
BR2_ARM_FPU_NEON=y
BR2_TOOLCHAIN_BUILDROOT_MUSL=y
BR2_TARGET_OPTIMIZATION="-fomit-frame-pointer -pipe"
BR2_TARGET_GENERIC_HOSTNAME="l3plus-ntp"
BR2_TARGET_GENERIC_ISSUE="L3+ NTP Server"
BR2_INIT_FINIT=y
BR2_TARGET_GENERIC_ROOT_PASSWD="12345"
BR2_TARGET_GENERIC_GETTY_TERM="linux"
BR2_ROOTFS_OVERLAY="/opt/l3plus/rootfs-overlay-ntp"
BR2_ROOTFS_POST_BUILD_SCRIPT="board/l3plus/post-build.sh"
BR2_ROOTFS_POST_IMAGE_SCRIPT="board/l3plus/post-image.sh"
BR2_PACKAGE_BUSYBOX_CONFIG_FRAGMENT_FILES="board/l3plus/busybox-no-init.fragment"
BR2_PACKAGE_BUSYBOX_SHOW_OTHERS=y
BR2_PACKAGE_ZSTD=y
BR2_PACKAGE_LSOF=y
BR2_PACKAGE_STRACE=y
BR2_PACKAGE_MTD=y
BR2_PACKAGE_MTD_JFFS2DUMP=y
BR2_PACKAGE_MTD_LSMTD=y
BR2_PACKAGE_MTD_MKFSJFFS2=y
BR2_PACKAGE_MTD_MKFSUBIFS=y
BR2_PACKAGE_MTD_MTDPART=y
BR2_PACKAGE_MTD_NANDFLIPBITS=y
BR2_PACKAGE_MTD_SUMTOOL=y
BR2_PACKAGE_GPSD=y
BR2_PACKAGE_I2C_TOOLS=y
BR2_PACKAGE_PPS_TOOLS=y
BR2_PACKAGE_UBOOT_TOOLS=y
BR2_PACKAGE_ZLIB=y
BR2_PACKAGE_ZLIB_NG=y
BR2_PACKAGE_LIBTOMCRYPT=y
BR2_PACKAGE_CHRONY=y
BR2_PACKAGE_DROPBEAR=y
BR2_PACKAGE_ETHTOOL=y
BR2_PACKAGE_LINUXPTP=y
BR2_PACKAGE_TESTPTP=y
BR2_PACKAGE_MKSH=y
BR2_PACKAGE_SCREEN=y
BR2_PACKAGE_HTOP=y
BR2_PACKAGE_NANO=y
BR2_TARGET_ROOTFS_CPIO=y
BR2_TARGET_ROOTFS_CPIO_ZSTD=y
BR2_PACKAGE_FINIT_ADVANCED=y
BR2_PACKAGE_FINIT_SULOGIN=y
BR2_PACKAGE_FINIT_WATCHDOG=y
BR2_PACKAGE_FINIT_PLUGIN_RTC=y
BR2_PACKAGE_FINIT_PLUGIN_TTY=y
BR2_PACKAGE_FINIT_PLUGIN_URANDOM=y
```
